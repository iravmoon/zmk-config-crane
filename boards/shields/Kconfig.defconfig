## boards/shields/Kconfig.defconfig
```kconfig
if SHIELD_CRANE_LEFT

# Name must be less than 16 characters long!
config ZMK_KEYBOARD_NAME
    default "Crane"

config ZMK_SPLIT_ROLE_CENTRAL
    default y

endif

if SHIELD_CRANE_LEFT || SHIELD_CRANE_RIGHT

config ZMK_SPLIT
    default y

endif
```

## boards/shields/crane/Kconfig.shield
```kconfig
# No whitespace after the comma or in your part name!
config SHIELD_CRANE_LEFT
    def_bool $(shields_list_contains,crane_left)

# No whitespace after the comma or in your part name!
config SHIELD_CRANE_RIGHT
    def_bool $(shields_list_contains,crane_right)
```
